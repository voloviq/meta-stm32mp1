## conf/machine/stm32mp157c-visionsom.conf
```bitbake
#@TYPE: Machine
#@NAME: stm32mp1 visionsom machine
#@DESCRIPTION: Reference machine configuration for https://somlabs.com/product/visionsom-stm32mp1/
#@MAINTAINER: Michal Wolowik <m.wolowik@emsyslabs.com>

require conf/machine/include/stm32mp1.inc
include conf/machine/include/tune-cortexa7.inc

# Kernel
PREFERRED_PROVIDER_virtual/kernel = "linux-stm32mp"
KERNEL_DEVICETREE ?= "stm32mp157a-visionsom-mx.dtb"
# U-Boot
PREFERRED_PROVIDER_virtual/bootloader = "u-boot-stm32mp-visionsom"
PREFERRED_PROVIDER_u-boot-stm32mpt-visionsom = "u-boot-stm32mp-visionsom"
SPL_BINARY = "u-boot-spl.stm32"
UBOOT_MAKE_TARGET = "DEVICE_TREE=stm32mp157a-visionsom-mx all"
UBOOT_MACHINE = "stm32mp15_visionsom_basic_defconfig"
UBOOT_EXTLINUX = "1"
UBOOT_EXTLINUX_FDT = "/boot/stm32mp157a-visionsom-mx.dtb"
UBOOT_EXTLINUX_ROOT = "root=/dev/mmcblk1p4"
UBOOT_EXTLINUX_CONSOLE = ""

MACHINE_FEATURES = "usbhost usbgadget alsa ext2 wifi bluetooh"

MACHINE_ESSENTIAL_EXTRA_RDEPENDS += " \
    kernel-image \
    kernel-devicetree \
    kernel-modules \
    u-boot \
    linux-firmware-bcm43430 \
"

PREFERRED_PROVIDER_libevent = "libevent-fb"
PREFERRED_PROVIDER_jpeg = "libjpeg-turbo"
PREFERRED_PROVIDER_jpeg-native = "libjpeg-turbo-native"

DISTRO_FEATURES_remove = "x11 wayland"

DISTRO_FEATURES += "directfb"
```
